## boards/shields/adv360pro/Kconfig.shield
```kconfig
# No whitespace after the comma or in the keyboard name!
config ADV360PRO_DONGLE
    def_bool $(shields_list_contains,adv360_dongle)
```

## boards/shields/adv_dongle/Kconfig.shield
```kconfig
# No whitespace after the comma or in the keyboard name!
config SHIELD_ADV_DONGLE
    def_bool $(shields_list_contains,adv_dongle)
```

## config/boards/shields/adv360pro/Kconfig.shield
```kconfig
# No whitespace after the comma or in the keyboard name!
config SHIELD_ADV360PRO_DONGLE
    def_bool $(shields_list_contains,adv360pro)
```
